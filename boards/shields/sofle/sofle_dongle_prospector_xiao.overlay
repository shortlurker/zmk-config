#include "sofle.dtsi"

/ {
    chosen {
        zmk,kscan = &mock_kscan;
    };

    mock_kscan: kscan_1 {
        compatible = "zmk,kscan-mock";
        columns = <0>;
        rows = <0>;
        events = <0>;
    };
};

/delete-node/ &kscan0;
/delete-node/ &left_encoder;
/delete-node/ &right_encoder;
/delete-node/ &sensors;
