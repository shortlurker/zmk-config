## config/boards/shields/sofle/Kconfig.shield
```kconfig
# Copyright (c) 2020 Ryan Cross
# SPDX-License-Identifier: MIT

config SHIELD_SOFLE_LEFT
    def_bool $(shields_list_contains,sofle_left)

config SHIELD_SOFLE_RIGHT
    def_bool $(shields_list_contains,sofle_right)

config SHIELD_SOFLE_DONGLE_OLED
    def_bool $(shields_list_contains,sofle_dongle_oled)

config SHIELD_SOFLE_DONGLE_PROSPECTOR_NN
    def_bool $(shields_list_contains,sofle_dongle_prospector_nn
    )
```

## config/west.yml
```yaml
manifest:
  remotes:
    - name: zmkfirmware
      url-base: https://github.com/zmkfirmware
    - name: petejohanson
      url-base: https://github.com/petejohanson
    - name: badjeff
      url-base: https://github.com/badjeff
    - name: carrefinho
      url-base: https://github.com/carrefinho
    - name: tokyo2006
      url-base: https://github.com/tokyo2006
    - name: urob
      url-base: https://github.com/urob
    - name: shortlurker
      url-base: https://github.com/shortlurker
  projects:
    - name: zmk
      remote: zmkfirmware
      revision: main
      import: app/west.yml
    #- name: zmk
    #  remote: petejohanson
    #  revision: feat/pointers-with-input-processors
    #  import: app/west.yml
    ## Modules ##
    - name: cirque-input-module
      remote: petejohanson
      revision: main
    - name: zmk-auto-layer
      remote: urob
      revision: main
    - name: prospector-zmk-module
      remote: shortlurker
      revision: nice_nano
  self:
    path: config
    
```
